#define MODULA_LEFT
#include "Modula_Base.dtsi"

// &pwm0 {status = "disabled";};
// &backlight {status = "disabled";};

/delete-node/ &kscan2; // ToDo: must be moved to module/snippet

/ {
    kscan2: kscan2 { // ToDo: must be moved to module/snippet
        compatible = "zmk,kscan-gpio-direct";
        wakeup-source;
        input-gpios
            = <&gpio0 4 (GPIO_ACTIVE_LOW | GPIO_PULL_UP)>
            ;
    };
};
