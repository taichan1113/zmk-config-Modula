#include <behaviors.dtsi>

/ {
    behaviors {
        /*
         * Layer-tap form. Example: &pht_lt MOUSE MB1
         * Hold: activate MOUSE. Tap/move: hold the specified mouse button.
         */
        pht_lt: pointer_hold_tap_lt {
            compatible = "modula,behavior-pointer-hold-tap";
            #binding-cells = <2>;
            flavor = "hold-preferred";
            hold-while-undecided;
            tapping-term-ms = <200>;
            bindings = <&mo>, <&mkp>;
        };

        /*
         * Mod-tap form. Example: &pht_mt LCTRL MB1
         * Hold: hold the modifier. Tap/move: hold the specified mouse button.
         */
        pht_mt: pointer_hold_tap_mt {
            compatible = "modula,behavior-pointer-hold-tap";
            #binding-cells = <2>;
            flavor = "hold-preferred";
            hold-while-undecided;
            tapping-term-ms = <200>;
            bindings = <&kp>, <&mkp>;
        };
    };
};
