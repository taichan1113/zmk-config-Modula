## Kconfig
```kconfig
menuconfig MODULA_BEHAVIOR_POINTER_HOLD_TAP
    bool "Pointer-motion-aware hold-tap behavior"
    depends on ZMK_POINTING
    default y
    help
      Resolves a hold-tap to its tap binding when relative pointer movement
      arrives while the key is still held.

if MODULA_BEHAVIOR_POINTER_HOLD_TAP

config MODULA_BEHAVIOR_POINTER_HOLD_TAP_MAX_HELD
    int "Maximum simultaneous pointer hold-taps"
    default 4
    range 1 10

endif
```

## boards/shields/Modula/Kconfig.defconfig
```kconfig
if SHIELD_MODULA_R
    config ZMK_SPLIT_ROLE_CENTRAL
        default y
endif

if SHIELD_MODULA_R||SHIELD_MODULA_L
    config ZMK_KEYBOARD_NAME
        default "Modula"

    config ZMK_SPLIT
        default y

    config ZMK_BACKLIGHT
        default y
    
endif 

if ZMK_BACKLIGHT

config PWM
    default y

config LED_PWM
    default y

endif # ZMK_BACKLIGHT
```

## config/west.yml
```yaml
manifest:
  remotes:
    - name: zmkfirmware
      url-base: https://github.com/zmkfirmware
    - name: caksoylar
      url-base: https://github.com/caksoylar
    - name: badjeff
      url-base: https://github.com/badjeff
    - name: sekigon-gonnoc
      url-base: https://github.com/sekigon-gonnoc
    - name: MaXMaNDeV
      url-base: https://github.com/MaXMaNDeV
    - name: BP
      url-base: https://github.com/taichan1113

  projects:
    - name: zmk
      remote: zmkfirmware
      revision: v0.3
      # revision: main
      import: app/west.yml

    - name: zmk-rgbled-widget  # https://github.com/caksoylar/zmk-rgbled-widget
      remote: caksoylar
      revision: v0.3-branch
      # revision: main

    # - name: zmk-pmw3610-driver # https://github.com/badjeff/zmk-pmw3610-driver
    #   remote: badjeff
    #   revision: zmk-v0.3
    #   revision: main

    - name: zmk-driver-paw3222
      remote: sekigon-gonnoc
      revision: main
      # revision: torabo-tsuki

    - name: zmk-input-processor-report-rate-limit # https://github.com/badjeff/zmk-input-processor-report-rate-limit
      remote: badjeff
      revision: main

    - name: zmk-input-processor-xyz
      remote: badjeff
      revision: main

    - name: zmk-driver-pat9125 # https://github.com/taichan1113/zmk-driver-pat9125
      remote: BP
      revision: main
    
    - name: zmk-pat912x-driver
      remote: MaXMaNDeV
      revision: main

    # - name: zmk-behavior-insomnia
    #   remote: badjeff
    #   revision: main

    - name: zmk-behavior-quick-scroll
      path: zmk-behavior-quick-scroll
      url: file:///home/takec/zmk-workspace/zmk-behavior-quick-scroll
      revision: main

    - name: zmk-typing-pwm
      path: zmk-typing-pwm
      url: file:///home/takec/zmk-workspace/zmk-typing-pwm
      revision: main

    - name: zmk-behavior-jp
      path: zmk-behavior-jp
      url: file:///home/takec/zmk-workspace/zmk-behavior-jp
      revision: v0.3

    - name: zmk-behavior-pointer-hold-tap
      path: zmk-behavior-pointer-hold-tap
      url: file:///home/takec/zmk-workspace/zmk-behavior-pointer-hold-tap
      revision: main

    # - name: zmk-layout-shift
    #   remote: kot149
    #   revision: v1

  self:
    path: config
    
```

## dts/bindings/behaviors/modula,behavior-pointer-hold-tap.yaml
```yaml
# SPDX-License-Identifier: MIT

description: Hold-tap that resolves to its tap binding on pointer movement

compatible: "modula,behavior-pointer-hold-tap"

include: two_param.yaml

properties:
  bindings:
    type: phandles
    required: true
  tapping-term-ms:
    type: int
    required: true
  quick-tap-ms:
    type: int
    default: -1
  require-prior-idle-ms:
    type: int
    default: -1
  flavor:
    type: string
    default: "hold-preferred"
    enum:
      - "hold-preferred"
      - "balanced"
      - "tap-preferred"
      - "tap-unless-interrupted"
  hold-while-undecided:
    type: boolean
```
